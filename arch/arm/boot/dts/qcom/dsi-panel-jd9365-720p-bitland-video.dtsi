/* Copyright (c) 2013, The Linux Foundation. All rights reserved.
 *
 * This program is free software; you can redistribute it and/or modify
 * it under the terms of the GNU General Public License version 2 and
 * only version 2 as published by the Free Software Foundation.
 *
 * This program is distributed in the hope that it will be useful,
 * but WITHOUT ANY WARRANTY; without even the implied warranty of
 * MERCHANTABILITY or FITNESS FOR A PARTICULAR PURPOSE.  See the
 * GNU General Public License for more details.
 */

/*---------------------------------------------------------------------------
 * This file is autogenerated file using gcdb parser. Please do not edit it.
 * Update input XML file to add a new entry or update variable in this file
 * VERSION = "1.0"
 *---------------------------------------------------------------------------*/
&mdss_mdp {
	dsi_jd9365_720p_bitland_video: qcom,mdss_dsi_jd9365_720p_bitland_video {
		qcom,mdss-dsi-panel-name = "jd9365_720p_bitland_video_mode_dsi_panel";
		qcom,mdss-dsi-panel-controller = <&mdss_dsi0>;
		qcom,mdss-dsi-panel-type = "dsi_video_mode";
		qcom,mdss-dsi-panel-destination = "display_1";
		qcom,mdss-dsi-panel-framerate = <60>;
		qcom,mdss-dsi-virtual-channel-id = <0>;
		qcom,mdss-dsi-stream = <0>;
		qcom,mdss-dsi-panel-width = <720>;
		qcom,mdss-dsi-panel-height = <1280>;
		qcom,mdss-dsi-h-front-porch = <60>;
		qcom,mdss-dsi-h-back-porch = <30>;
		qcom,mdss-dsi-h-pulse-width = <20>;
		qcom,mdss-dsi-h-sync-skew = <0>;
		qcom,mdss-dsi-v-back-porch = <9>;
		qcom,mdss-dsi-v-front-porch = <20>;
		qcom,mdss-dsi-v-pulse-width = <4>;
		qcom,mdss-dsi-h-left-border = <0>;
		qcom,mdss-dsi-h-right-border = <0>;
		qcom,mdss-dsi-v-top-border = <0>;
		qcom,mdss-dsi-v-bottom-border = <0>;
		qcom,mdss-dsi-bpp = <24>;
		qcom,mdss-dsi-color-order = "rgb_swap_rgb";
		qcom,mdss-dsi-underflow-color = <0xff>;
		qcom,mdss-dsi-border-color = <0>;
		qcom,mdss-dsi-on-command = [39 01 00 00 00 00 02 E0 00
39 01 00 00 00 00 02 E1 93
39 01 00 00 00 00 02 E2 65
39 01 00 00 00 00 02 E3 F8
39 01 00 00 00 00 02 80 03
39 01 00 00 00 00 02 E0 01
39 01 00 00 00 00 02 00 00
39 01 00 00 00 00 02 01 AB
39 01 00 00 00 00 02 03 00
39 01 00 00 00 00 02 04 EA
39 01 00 00 00 00 02 0C 64
39 01 00 00 00 00 02 17 00
39 01 00 00 00 00 02 18 F7
39 01 00 00 00 00 02 19 01
39 01 00 00 00 00 02 1A 00
39 01 00 00 00 00 02 1B F7
39 01 00 00 00 00 02 1C 01
39 01 00 00 00 00 02 1F 7E
39 01 00 00 00 00 02 20 28
39 01 00 00 00 00 02 21 28
39 01 00 00 00 00 02 22 4E
39 01 00 00 00 00 02 35 76
39 01 00 00 00 00 02 37 09
39 01 00 00 00 00 02 38 04
39 01 00 00 00 00 02 39 08
39 01 00 00 00 00 02 3A 12
39 01 00 00 00 00 02 3C 78
39 01 00 00 00 00 02 3D FF
39 01 00 00 00 00 02 3E FF
39 01 00 00 00 00 02 3F 7F
39 01 00 00 00 00 02 40 04
39 01 00 00 00 00 02 41 A0
39 01 00 00 00 00 02 43 0F
39 01 00 00 00 00 02 44 11
39 01 00 00 00 00 02 45 28
39 01 00 00 00 00 02 55 0F
39 01 00 00 00 00 02 56 01
39 01 00 00 00 00 02 57 A9
39 01 00 00 00 00 02 58 0A
39 01 00 00 00 00 02 59 0A
39 01 00 00 00 00 02 5A 7C
39 01 00 00 00 00 02 5B 14
39 01 00 00 00 00 02 5C 15
39 01 00 00 00 00 02 5D 73
39 01 00 00 00 00 02 5E 5C
39 01 00 00 00 00 02 5F 4B
39 01 00 00 00 00 02 60 3F
39 01 00 00 00 00 02 61 3B
39 01 00 00 00 00 02 62 2B
39 01 00 00 00 00 02 63 2E
39 01 00 00 00 00 02 64 17
39 01 00 00 00 00 02 65 2E
39 01 00 00 00 00 02 66 2C
39 01 00 00 00 00 02 67 2C
39 01 00 00 00 00 02 68 4B
39 01 00 00 00 00 02 69 39
39 01 00 00 00 00 02 6A 41
39 01 00 00 00 00 02 6B 33
39 01 00 00 00 00 02 6C 30
39 01 00 00 00 00 02 6D 24
39 01 00 00 00 00 02 6E 18
39 01 00 00 00 00 02 6F 0E
39 01 00 00 00 00 02 70 73
39 01 00 00 00 00 02 71 5C
39 01 00 00 00 00 02 72 4B
39 01 00 00 00 00 02 73 3F
39 01 00 00 00 00 02 74 3B
39 01 00 00 00 00 02 75 2B
39 01 00 00 00 00 02 76 2E
39 01 00 00 00 00 02 77 17
39 01 00 00 00 00 02 78 2E
39 01 00 00 00 00 02 79 2C
39 01 00 00 00 00 02 7A 2C
39 01 00 00 00 00 02 7B 4B
39 01 00 00 00 00 02 7C 39
39 01 00 00 00 00 02 7D 41
39 01 00 00 00 00 02 7E 33
39 01 00 00 00 00 02 7F 30
39 01 00 00 00 00 02 80 24
39 01 00 00 00 00 02 81 18
39 01 00 00 00 00 02 82 0E
39 01 00 00 00 00 02 E0 02
39 01 00 00 00 00 02 5C 03
39 01 00 00 00 00 02 63 1B
39 01 00 00 00 00 02 64 60
39 01 00 00 00 00 02 68 06
39 01 00 00 00 00 02 6A 60
39 01 00 00 00 00 02 6D 04
39 01 00 00 00 00 02 78 1F
39 01 00 00 00 00 02 7F 40
39 01 00 00 00 00 02 E0 04
39 01 00 00 00 00 02 2D 03
39 01 00 00 00 00 02 2B 2B
39 01 00 00 00 00 02 2E 44
39 01 00 00 00 00 02 E0 00
39 01 00 00 00 00 02 E6 02
39 01 00 00 00 00 02 E7 02
05 01 00 00 78 00 02 11 00 
05 01 00 00 14 00 02 29 00];
		qcom,mdss-dsi-off-command = [05 01 00 00 FA 00 02 28 00
					05 01 00 00 0A 00 02 10 00];
		qcom,mdss-dsi-on-command-state = "dsi_lp_mode";
		qcom,mdss-dsi-off-command-state = "dsi_hs_mode";
		qcom,mdss-dsi-h-sync-pulse = <1>;
		qcom,mdss-dsi-traffic-mode = "burst_mode";
		qcom,mdss-dsi-lane-map = "lane_map_0123";
		qcom,mdss-dsi-bllp-eof-power-mode;
		qcom,mdss-dsi-bllp-power-mode;
		qcom,mdss-dsi-lp11-init;
		qcom,mdss-dsi-lane-0-state;
		qcom,mdss-dsi-lane-1-state;
		qcom,mdss-dsi-lane-2-state;
		qcom,mdss-dsi-lane-3-state;
		qcom,mdss-dsi-panel-timings = [76 18 10 00 3C 3E 14 1C 12 03 04 00];
		qcom,mdss-dsi-t-clk-post = <0x04>;
		qcom,mdss-dsi-t-clk-pre = <0x19>;
		qcom,mdss-dsi-bl-min-level = <1>;
		qcom,mdss-dsi-bl-max-level = <255>;
		qcom,mdss-dsi-dma-trigger = "trigger_sw";
		qcom,mdss-dsi-mdp-trigger = "none";
		qcom,mdss-dsi-bl-pmic-control-type = "bl_ctrl_pwm";  /* add by liuyang 20160602 for bl*/
        qcom,mdss-dsi-bl-pmic-pwm-frequency = <60>; 
        qcom,mdss-dsi-bl-pmic-bank-select = <0>; 
        qcom,mdss-dsi-pwm-gpio = <&pm8937_gpios 8 0>;
		qcom,mdss-dsi-reset-sequence = <1 10>, <0 10>, <1 20>;
	};
};
