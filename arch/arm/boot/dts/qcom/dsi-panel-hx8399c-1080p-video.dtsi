/* Copyright (c) 2013, The Linux Foundation. All rights reserved.
 *
 * This program is free software; you can redistribute it and/or modify
 * it under the terms of the GNU General Public License version 2 and
 * only version 2 as published by the Free Software Foundation.
 *
 * This program is distributed in the hope that it will be useful,
 * but WITHOUT ANY WARRANTY; without even the implied warranty of
 * MERCHANTABILITY or FITNESS FOR A PARTICULAR PURPOSE.  See the
 * GNU General Public License for more details.
 */

/*---------------------------------------------------------------------------
 * This file is autogenerated file using gcdb parser. Please do not edit it.
 * Update input XML file to add a new entry or update variable in this file
 * VERSION = "1.0"
 *---------------------------------------------------------------------------*/
&mdss_mdp {
	dsi_hx8399c_1080p_video: qcom,mdss_dsi_hx8399c_1080p_video {
		qcom,mdss-dsi-panel-name = "hx8399c 1080p video mode dsi panel";
		qcom,mdss-dsi-panel-controller = <&mdss_dsi0>;
		qcom,mdss-dsi-panel-type = "dsi_video_mode";
		qcom,mdss-dsi-panel-destination = "display_1";
		qcom,mdss-dsi-panel-framerate = <60>;
		qcom,mdss-dsi-virtual-channel-id = <0>;
		qcom,mdss-dsi-stream = <0>;
		qcom,mdss-dsi-panel-width = <1080>;
		qcom,mdss-dsi-panel-height = <1920>;
		qcom,mdss-dsi-h-front-porch = <30>;
		qcom,mdss-dsi-h-back-porch = <60>;
		qcom,mdss-dsi-h-pulse-width = <8>;
		qcom,mdss-dsi-h-sync-skew = <0>;
		qcom,mdss-dsi-v-back-porch = <3>;
		qcom,mdss-dsi-v-front-porch = <10>;
		qcom,mdss-dsi-v-pulse-width = <4>;
		qcom,mdss-dsi-h-left-border = <0>;
		qcom,mdss-dsi-h-right-border = <0>;
		qcom,mdss-dsi-v-top-border = <0>;
		qcom,mdss-dsi-v-bottom-border = <0>;
		qcom,mdss-dsi-bpp = <24>;
		qcom,mdss-dsi-color-order = "rgb_swap_rgb";
		qcom,mdss-dsi-underflow-color = <0xff>;
		qcom,mdss-dsi-border-color = <0>;
		qcom,mdss-dsi-on-command = [39 01 00 00 00 00 04 B9 FF 83 99 
39 01 00 00 00 00 10 B1 02 04 6A \
8A 01 32 33 11 11 4F 45 56 73 02 \
02 
39 01 00 00 00 00 0C B2 00 80 80 \
AE 05 07 5A 11 10 10 00 
39 01 00 00 00 00 2D B4 00 FF 00 \
AC 00 9C 00 00 08 00 00 02 00 24 \
02 04 0C 21 03 00 00 04 A4 88 00 \
A0 00 A0 00 00 08 00 00 02 00 28 \
02 04 0C 00 00 04 A4 12 
39 01 00 00 00 00 22 D3 00 00 00 \
00 00 00 00 00 32 10 05 00 05 00 \
00 00 00 00 00 00 00 00 00 01 00 \
07 07 03 00 00 00 05 40 
39 01 00 00 00 00 21 D5 00 00 00 \
01 02 03 00 00 00 00 19 00 18 18 \
20 21 00 18 00 19 00 00 00 00 00 \
00 31 31 30 30 2F 2F 
39 01 00 00 00 00 21 D6 40 40 03 \
02 01 00 40 40 40 40 18 40 19 18 \
21 20 40 18 40 19 40 40 40 40 40 \
40 31 31 30 30 2F 2F 
39 01 00 00 00 00 11 D8 28 2A 00 \
2A 28 0E B0 2A 28 2A 00 2A 28 0A \
A0 2A 
39 01 00 00 00 00 02 BD 01 
39 01 00 00 00 00 11 D8 00 00 00 \
00 00 00 00 00 28 2a 00 2a 28 0a \
e0 2a 
39 01 00 00 00 00 02 BD 02 
39 01 00 00 00 00 09 D8 28 2A 00 \
2A 28 0A E0 2A 
39 01 00 00 00 00 02 BD 00 
39 01 00 00 00 00 37 E0 01 24 2f \
2a 57 5e 6A 64 6B 72 79 80 83 89 \
93 92 92 9B 9C a1 92 9e 9F 54 52 \
5C 69 01 24 2f 2a 57 5e 6A 64 6B \
72 79 80 83 89 93 92 92 9B 9C a1 \
92 9e 9F 54 52 5C 69 
39 01 00 00 00 00 02 D2 22 
39 01 00 00 00 00 04 B6 7d 7d 00 
39 01 00 00 00 00 02 CC 08
39 01 00 00 00 00 02 D0 39
05 01 00 00 78 00 02 11 00 
05 01 00 00 0A 00 02 29 00];
		qcom,mdss-dsi-off-command = [05 01 00 00 14 00 02 28 00
					05 01 00 00 78 00 02 10 00
					39 01 00 00 00 00 04 B9 FF 83 99
					15 01 00 00 00 00 02 B1 01];
		qcom,mdss-dsi-on-command-state = "dsi_lp_mode";
		qcom,mdss-dsi-off-command-state = "dsi_lp_mode";
		qcom,mdss-dsi-h-sync-pulse = <1>;
		qcom,mdss-dsi-traffic-mode = "burst_mode";
		qcom,mdss-dsi-lane-map = "lane_map_0123";
		qcom,mdss-dsi-bllp-eof-power-mode;
		qcom,mdss-dsi-bllp-power-mode;
		qcom,mdss-dsi-lp11-init;
		qcom,mdss-dsi-lane-0-state;
		qcom,mdss-dsi-lane-1-state;
		qcom,mdss-dsi-lane-2-state;
		qcom,mdss-dsi-lane-3-state;
		qcom,mdss-dsi-panel-timings = [D6 34 22 00 62 66 26 36 28 03 04 00];
		qcom,mdss-dsi-t-clk-post = <0x03>;
		qcom,mdss-dsi-t-clk-pre = <0x28>;
		qcom,mdss-dsi-bl-min-level = <1>;
		qcom,mdss-dsi-bl-max-level = <255>;
		qcom,mdss-dsi-dma-trigger = "trigger_sw";
		qcom,mdss-dsi-mdp-trigger = "none";
		qcom,mdss-dsi-bl-pmic-control-type = "bl_ctrl_pwm";  /* add by liuyang 20160602 for bl*/
		qcom,mdss-dsi-bl-pmic-pwm-frequency = <60>; 
        	qcom,mdss-dsi-bl-pmic-bank-select = <0>; 
        	qcom,mdss-dsi-pwm-gpio = <&pm8937_gpios 8 0>;
		qcom,mdss-dsi-reset-sequence = <1 2>, <0 1>, <1 50>;
		qcom,esd-check-enabled;
		qcom,mdss-dsi-panel-status-check-mode = "reg_read";
		qcom,mdss-dsi-panel-status-command
			= [14 01 00 01 05 00 02 0A 00
			06 01 00 01 05 00 02 09 00];
		qcom,mdss-dsi-panel-status-command-state = "dsi_lp_mode";
		qcom,mdss-dsi-panel-status-read-length = <1 3>;
		qcom,mdss-dsi-panel-status-value = <0x9D 0x80 0x73 0x04>;
		qcom,mdss-pan-physical-width-dimension = <68>;
		qcom,mdss-pan-physical-height-dimension = <121>;
	};
};
