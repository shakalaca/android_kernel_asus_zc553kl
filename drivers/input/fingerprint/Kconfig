## drivers/input/fingerprint/Kconfig
```kconfig
#
#Fingerprint
#
menu "Finger support"
	depends on !UML

config INPUT_FINGERPRINT
	tristate "Mediatek Fingerprint"
	default n
	---help---
	Fingerprint mtk driver enable/disable in the kernel.
	Say Y here if you want to use mediatek fingerprint driver,
	fingerprint driver will support fingerprint function in REE,
	it supports Goodix's GF316M/GF318M/GF3118M/GF518M/GF5118M/GF516M/GF816M/GF3208/GF5216... device.

if INPUT_FINGERPRINT

config GOODIX_FINGERPRINT
	tristate "Goodix Fingerprint"
	default n
	---help---
	Goodix Fingerprint chip GF316M/GF318M/GF3118M/GF518M/GF5118M/GF516M/GF816M/GF3208/GF5216 TEE driver

endif

endmenu
```

## drivers/input/touchscreen/ft5436/Kconfig
```kconfig
config TOUCHSCREEN_FT5436_DRIVER
	tristate "FOCALTECH FT5436 touchpanel driver"
	default n
	help
	  This is the main file for touchpanel driver for FOCALTECH FT5436
	  touchscreens.

	  Say Y here if you have a FOCALTECH FT5436 touchscreen connected
	  to your system.

	  If unsure, say N.
```
